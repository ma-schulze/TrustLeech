## artifact/buildroot/boot/rmm/Config.in
```kconfig
config BR2_TARGET_REALM_MANAGEMENT_MONITOR
	bool "ARM REALM MANAGEMENT MONITOR (RMM)"
	help 
	  Enable this option if you want to build the RMM


config BR2_TARGET_REALM_MANAGEMENT_MONITOR_RMM_CONFIG
	string "RMM config"
	help
	  Target config to build for.


config BR2_TARGET_REALM_MANAGEMENT_MONITOR_ADDITIONAL_VARIABLES
	string "Additional RMM build variables"
	help
	  Additional parameters for the RMM build
	  E.G. 'DEBUG=1 LOG_LEVEL=20'
```

## artifact/buildroot/package/libvmi/Config.in
```kconfig
config BR2_PACKAGE_LIBVMI
	bool "libvmi"
	depends on BR2_PACKAGE_LIBGLIB2 # libglib2
	depends on BR2_PACKAGE_JSON_C # libglib2
	depends on BR2_PACKAGE_ZLIB # fork()
	# depends on BR2_PACKAGE_LIBVIRT
	help
      libvmi
```

## artifact/buildroot/package/vmi_client/Config.in
```kconfig
config BR2_PACKAGE_VMI_CLIENT
	bool "vmi_client"
	depends on BR2_PACKAGE_LIBVMI
	help
      vmi_client
```
